## external/package/Config.in
```kconfig
# menu "Graphic libraries and applications (graphic/text)"

comment "rockchip libMali"
# endmenu
    source "$BR2_EXTERNAL_OrangePi_4_PATH/package/libmali-midgard/Config.in"
# comment "rockchip wifi-bt tools"
#     source "$BR2_EXTERNAL_OrangePi_4_PATH/package/rkwifibt/Config.in"
menu "Qt5 Single package"
    source "$BR2_EXTERNAL_OrangePi_4_PATH/package/qt5_single/Config.in"
endmenu
```

## external/package/libmali-midgard/Config.in
```kconfig
config BR2_PACKAGE_LIBMALI_MIDGARD
	bool "libmali-midgard"
	depends on BR2_TOOLCHAIN_USES_GLIBC
	depends on BR2_ARM_EABIHF || BR2_aarch64
	# lidbrm. This would normally need a Config.in comment, but
	# these blobs are linked against glibc, so we are sure to have
	# thread support, so don't bother.
	depends on BR2_TOOLCHAIN_HAS_THREADS
	select BR2_PACKAGE_HAS_LIBEGL
	select BR2_PACKAGE_HAS_LIBGLES
	select BR2_PACKAGE_HAS_LIBGBM
	select BR2_PACKAGE_LIBGBM_HAS_FEATURE_DMA_BUF
	select BR2_PACKAGE_LIBDRM
	help
	  Install the binary user-space libraries for the ARM Mali GPU
	  suitable for Rockchip platforrms. This package requires a
	  kernel with the ARM Mali GPU kernel driver enabled, as found
	  in the 'mali-driver' package.

if BR2_PACKAGE_LIBMALI_MIDGARD

config BR2_PACKAGE_PROVIDES_LIBEGL
	default "libmali-midgard"

config BR2_PACKAGE_PROVIDES_LIBGLES
	default "libmali-midgard"

config BR2_PACKAGE_PROVIDES_LIBGBM
	default "libmali-midgard"

endif
```

## external/package/qt5_single/Config.in
```kconfig
config BR2_PACKAGE_QT5_SINGLE_GL_AVAILABLE
	bool
	default y
	depends on BR2_PACKAGE_HAS_LIBGL || BR2_PACKAGE_HAS_LIBGLES

config BR2_PACKAGE_QT5_SINGLE_JSCORE_AVAILABLE
	bool
	default y
	# Javascript engine is only available on certain architectures
	depends on BR2_arm || BR2_aarch64 || BR2_i386 || BR2_x86_64 || BR2_mipsel || BR2_arc
	# ARM needs BLX, so v5t+
	depends on !BR2_ARM_CPU_ARMV4

comment "Qt5 needs host g++ >= 5.0, and a toolchain w/ gcc >= 5.0, wchar, NPTL, C++ "
	depends on !BR2_ARM_CPU_ARMV4
	depends on !BR2_INSTALL_LIBSTDCPP || !BR2_USE_WCHAR || \
		!BR2_TOOLCHAIN_HAS_THREADS_NPTL || \
		!BR2_HOST_GCC_AT_LEAST_5 || !BR2_TOOLCHAIN_GCC_AT_LEAST_5

config BR2_PACKAGE_QT5_SINGLE
	bool "qt5_single"
	depends on BR2_INSTALL_LIBSTDCPP
	depends on BR2_USE_WCHAR
	depends on BR2_TOOLCHAIN_HAS_THREADS_NPTL
	depends on BR2_HOST_GCC_AT_LEAST_5 # Full C++11
	depends on BR2_TOOLCHAIN_GCC_AT_LEAST_5 # C++11, GCC_BUG_57694
	depends on !BR2_ARM_CPU_ARMV4 # needs ARMv5+
	select BR2_PACKAGE_ZLIB
	select BR2_PACKAGE_PCRE2
	select BR2_PACKAGE_PCRE2_16
	select BR2_PACKAGE_LIBOPENSSL_ENABLE_PSK if BR2_PACKAGE_LIBOPENSSL
	help
	  Qt is a cross-platform application and UI framework for
	  developers using C++.
	  
	  This option enables the Qt5 qt5base module, which
	  contains the base Qt libraries: QtCore, QtNetwork, QtGui,
	  QtWidgets, etc.. Sub-options allow to
	  select which modules should be built.

	  https://qt.io

if BR2_PACKAGE_QT5_SINGLE

		config BR2_PACKAGE_QT5_SINGLE_CUSTOM_CONF_OPTS
			string "Custom configuration options"
			help
			Define custom qt5 configuration options which can be used to
			enable or disable options not managed by buildroot. These
			options are appended to the ones generated by buildroot and
			passed to qt5base during configuration.

			E.g. to remove the Windows Vista style option, add the option
			-no-feature-style_windowsvista.

		config BR2_PACKAGE_QT5_SINGLE_CONFIG_FILE
			string "Config file"
			help
			Configure options allow to set which modules are being
			compiled or not in Qt, but Qt also provide a more
			fine-grained mechanism to configure which features should be
			enabled or disabled, through a header file. Examples of such
			header files can be found in src/corelib/global/qconfig-*.h
			in the Qt sources.

			This option allows to set the path of such a configuration
			file, which Buildroot will give to Qt at compile time.

		config BR2_PACKAGE_QT5_SINGLE_EXAMPLES
			bool "Compile and install examples (with code)"
			select BR2_PACKAGE_QT5_SINGLE_NETWORK
			select BR2_PACKAGE_QT5_SINGLE_XML
			help
			If unsure, say N.

		config BR2_PACKAGE_QT5_SINGLE_NETWORK
			def_bool y

		config BR2_PACKAGE_QT5_SINGLE_CONCURRENT
			bool "concurrent module"
			help
			This options enables the Qt5Concurrent library.

		config BR2_PACKAGE_QT5_SINGLE_SQL
			def_bool y

		if BR2_PACKAGE_QT5_SINGLE_SQL
		config BR2_PACKAGE_QT5_SINGLE_MYSQL
			bool "MySQL Plugin"
			depends on BR2_USE_MMU # mysql
			select BR2_PACKAGE_MYSQL
			select BR2_PACKAGE_NCURSES
			select BR2_PACKAGE_READLINE
			help
			Build MySQL plugin
			If unsure, say n.

		config BR2_PACKAGE_QT5_SINGLE_PSQL
			bool "PostgreSQL Plugin"
			depends on BR2_USE_MMU # postgresql
			depends on !BR2_STATIC_LIBS
			depends on BR2_USE_WCHAR # postgresql
			select BR2_PACKAGE_POSTGRESQL
			help
			Build PostgreSQL plugin
			If unsure, say n.

		comment "PostgreSQL plugin needs a toolchain w/ wchar, dynamic library"
			depends on BR2_USE_MMU
			depends on BR2_STATIC_LIBS || !BR2_USE_WCHAR

		choice
			prompt "SQLite 3 support"
			default BR2_PACKAGE_QT5_SINGLE_SQLITE_NONE
			help
			Select SQLite support.

		config BR2_PACKAGE_QT5_SINGLE_SQLITE_NONE
			bool "No sqlite support"
			help
			Do not compile any kind of SQLite support.

		config BR2_PACKAGE_QT5_SINGLE_SQLITE_QT
			bool "Qt SQLite"
			help
			Use Qt bundled SQLite support.

		config BR2_PACKAGE_QT5_SINGLE_SQLITE_SYSTEM
			bool "System SQLite"
			select BR2_PACKAGE_SQLITE
			select BR2_PACKAGE_SQLITE_ENABLE_COLUMN_METADATA
			help
			Use system SQLite.

		endchoice

		endif

		config BR2_PACKAGE_QT5_SINGLE_TEST
			def_bool y

		config BR2_PACKAGE_QT5_SINGLE_XML
			def_bool y

		config BR2_PACKAGE_QT5_SINGLE_GUI
			bool "gui module"
			select BR2_PACKAGE_FREETYPE
			# At least one graphic backend must be enabled, so enable
			# linuxfb if nothing is enabled.
			select BR2_PACKAGE_QT5_SINGLE_LINUXFB if \
				!BR2_PACKAGE_QT5_SINGLE_DIRECTFB && \
				!BR2_PACKAGE_QT5_SINGLE_XCB && \
				!BR2_PACKAGE_QT5_SINGLE_EGLFS
			help
			This option enables the Qt5Gui library.

		if BR2_PACKAGE_QT5_SINGLE_GUI

		config BR2_PACKAGE_QT5_SINGLE_WIDGETS
			bool "widgets module"
			select BR2_PACKAGE_XLIB_LIBXEXT if BR2_PACKAGE_QT5_SINGLE_XCB
			help
			This option enables the Qt5Widgets library.

		comment "OpenGL support needs an OpenGL-capable backend"
			depends on !BR2_PACKAGE_QT5_SINGLE_GL_AVAILABLE

		config BR2_PACKAGE_QT5_SINGLE_OPENGL
			bool "OpenGL support"
			depends on BR2_PACKAGE_QT5_SINGLE_GL_AVAILABLE
			help
			This option enables OpenGL support.

		if BR2_PACKAGE_QT5_SINGLE_OPENGL

		choice
			prompt "OpenGL API"
			help
			Select OpenGL API.

		config BR2_PACKAGE_QT5_SINGLE_OPENGL_DESKTOP
			bool "Desktop OpenGL"
			depends on BR2_PACKAGE_HAS_LIBGL
			help
			Use desktop OpenGL.

		config BR2_PACKAGE_QT5_SINGLE_OPENGL_ES2
			bool "OpenGL ES 2.0+"
			depends on BR2_PACKAGE_HAS_LIBGLES
			help
			Use OpenGL ES 2.0 and later versions.

		endchoice

		config BR2_PACKAGE_QT5_SINGLE_OPENGL_LIB
			bool "opengl module"
			select BR2_PACKAGE_QT5_SINGLE_WIDGETS
			help
			This option enables the Qt5OpenGL library. This library
			includes OpenGL support classes provided to ease porting
			from Qt 4.x.

		endif

		config BR2_PACKAGE_QT5_SINGLE_LINUXFB
			bool "linuxfb support"

		config BR2_PACKAGE_QT5_SINGLE_DIRECTFB
			bool "directfb support"
			depends on BR2_PACKAGE_DIRECTFB

		comment "directfb backend available if directfb is enabled"
			depends on !BR2_PACKAGE_DIRECTFB

		config BR2_PACKAGE_QT5_SINGLE_XCB
			bool "X.org XCB support"
			depends on BR2_PACKAGE_XORG7
			select BR2_PACKAGE_XLIB_LIBX11
			select BR2_PACKAGE_LIBXCB
			select BR2_PACKAGE_XCB_UTIL_IMAGE
			select BR2_PACKAGE_XCB_UTIL_KEYSYMS
			select BR2_PACKAGE_XCB_UTIL_RENDERUTIL
			select BR2_PACKAGE_XCB_UTIL_WM
			select BR2_PACKAGE_LIBXKBCOMMON

		comment "X.org XCB backend available if X.org is enabled"
			depends on !BR2_PACKAGE_XORG7

		config BR2_PACKAGE_QT5_SINGLE_EGLFS
			bool "eglfs support"
			depends on BR2_PACKAGE_HAS_LIBEGL
			depends on BR2_PACKAGE_QT5_SINGLE_GL_AVAILABLE
			select BR2_PACKAGE_QT5_SINGLE_OPENGL

		comment "eglfs backend available if OpenGL and EGL are enabled"
			depends on !BR2_PACKAGE_HAS_LIBEGL || !BR2_PACKAGE_QT5_SINGLE_GL_AVAILABLE

		config BR2_PACKAGE_QT5_SINGLE_DEFAULT_QPA
			string "Default graphical platform"
			help
			Choose the default platform abstraction to use for graphical
			applications (e.g xcb, linuxfb, eglfs, ...). If this is
			empty, the default for your architecture will be used
			(usually this is eglfs).

			You can get a list of supported platforms by running a Qt
			application with the option "-platform help" on your
			target. You can choose a different platform at runtime with
			the -platform option.

		config BR2_PACKAGE_QT5_SINGLE_PRINTSUPPORT
			depends on BR2_PACKAGE_QT5_SINGLE_WIDGETS
			def_bool y

		config BR2_PACKAGE_QT5_SINGLE_FONTCONFIG
			bool "fontconfig support"
			select BR2_PACKAGE_FONTCONFIG
			help
			This option enables Fontconfig and Freetype support using
			the system fontconfig and freetype2 libraries.

		config BR2_PACKAGE_QT5_SINGLE_HARFBUZZ
			bool "harfbuzz support"
			select BR2_PACKAGE_HARFBUZZ if \
				BR2_TOOLCHAIN_HAS_SYNC_4 && \
				BR2_TOOLCHAIN_GCC_AT_LEAST_4_9
			help
			This option enables HarfBuzz support (either system harfbuzz
			if the toolchain supports __sync for 4 bytes, or the qt
			provided one which avoids this dependency by using QAtomic).

		config BR2_PACKAGE_QT5_SINGLE_GIF
			bool "GIF support"
			help
			This compiles and installs the plugin for GIF reading support.

		config BR2_PACKAGE_QT5_SINGLE_JPEG
			bool "JPEG support"
			select BR2_PACKAGE_JPEG
			help
			This option enables JPEG support using the system libjpeg
			library.

		config BR2_PACKAGE_QT5_SINGLE_PNG
			bool "PNG support"
			select BR2_PACKAGE_LIBPNG
			help
			This option enables PNG support using the system libpng
			library.

		endif

		config BR2_PACKAGE_QT5_SINGLE_SYSLOG
			bool "syslog support"
			help
			Logs to the standard UNIX logging mechanism.

		config BR2_PACKAGE_QT5_SINGLE_DBUS
			bool "DBus module"
			depends on BR2_TOOLCHAIN_HAS_THREADS
			depends on BR2_USE_MMU
			select BR2_PACKAGE_DBUS
			help
			This option enables the D-Bus module.

		config BR2_PACKAGE_QT5_SINGLE_ICU
			bool "Enable ICU support"
			depends on !BR2_BINFMT_FLAT # icu
			depends on BR2_HOST_GCC_AT_LEAST_4_9 # icu
			depends on BR2_TOOLCHAIN_GCC_AT_LEAST_4_9 # icu
			select BR2_PACKAGE_ICU
			help
			This option enables ICU support in Qt5. This is for example
			needed for Qt5Webkit.

		comment "icu support needs a toolchain w/ gcc >= 4.9, host gcc >= 4.9"
			depends on !BR2_BINFMT_FLAT
			depends on !BR2_TOOLCHAIN_GCC_AT_LEAST_4_9 || \
				!BR2_HOST_GCC_AT_LEAST_4_9

		config BR2_PACKAGE_QT5_SINGLE_TSLIB
			bool "Enable Tslib support"
			select BR2_PACKAGE_TSLIB
			help
			This options enables the Tslib plugin

		config BR2_PACKAGE_QT5_SINGLE_MTDEV
			bool "Enable MTDev support"
			select BR2_PACKAGE_MTDEV
			help
			This options enables the Tslib plugin






		source "$BR2_EXTERNAL_OrangePi_4_PATH/package/qt5_single/qt5_single_3d/Config.in"
		source "$BR2_EXTERNAL_OrangePi_4_PATH/package/qt5_single/qt5_single_charts/Config.in"
		# source "$BR2_EXTERNAL_OrangePi_4_PATH/package/qt5_single/qt5_single_coap/Config.in"
		source "$BR2_EXTERNAL_OrangePi_4_PATH/package/qt5_single/qt5_single_connectivity/Config.in"
		source "$BR2_EXTERNAL_OrangePi_4_PATH/package/qt5_single/qt5_single_declarative/Config.in"
		# source "$BR2_EXTERNAL_OrangePi_4_PATH/package/qt5_single/qt5_single_enginio/Config.in"
		source "$BR2_EXTERNAL_OrangePi_4_PATH/package/qt5_single/qt5_single_graphicaleffects/Config.in"
		source "$BR2_EXTERNAL_OrangePi_4_PATH/package/qt5_single/qt5_single_imageformats/Config.in"
		# source "$BR2_EXTERNAL_OrangePi_4_PATH/package/qt5_single/qt5_single_knx/Config.in"
		source "$BR2_EXTERNAL_OrangePi_4_PATH/package/qt5_single/qt5_single_location/Config.in"
		source "$BR2_EXTERNAL_OrangePi_4_PATH/package/qt5_single/qt5_single_lottie/Config.in"
		# source "$BR2_EXTERNAL_OrangePi_4_PATH/package/qt5_single/qt5_single_mqtt/Config.in"
		source "$BR2_EXTERNAL_OrangePi_4_PATH/package/qt5_single/qt5_single_multimedia/Config.in"
		# source "$BR2_EXTERNAL_OrangePi_4_PATH/package/qt5_single/qt5_single_opcua/Config.in"
		source "$BR2_EXTERNAL_OrangePi_4_PATH/package/qt5_single/qt5_single_quickcontrols/Config.in"
		source "$BR2_EXTERNAL_OrangePi_4_PATH/package/qt5_single/qt5_single_quickcontrols2/Config.in"
		source "$BR2_EXTERNAL_OrangePi_4_PATH/package/qt5_single/qt5_single_quicktimeline/Config.in"
		source "$BR2_EXTERNAL_OrangePi_4_PATH/package/qt5_single/qt5_single_remoteobjects/Config.in"
		source "$BR2_EXTERNAL_OrangePi_4_PATH/package/qt5_single/qt5_single_script/Config.in"
		source "$BR2_EXTERNAL_OrangePi_4_PATH/package/qt5_single/qt5_single_scxml/Config.in"
		source "$BR2_EXTERNAL_OrangePi_4_PATH/package/qt5_single/qt5_single_sensors/Config.in"
		source "$BR2_EXTERNAL_OrangePi_4_PATH/package/qt5_single/qt5_single_serialbus/Config.in"
		source "$BR2_EXTERNAL_OrangePi_4_PATH/package/qt5_single/qt5_single_serialport/Config.in"
		source "$BR2_EXTERNAL_OrangePi_4_PATH/package/qt5_single/qt5_single_svg/Config.in"
		# source "$BR2_EXTERNAL_OrangePi_4_PATH/package/qt5_single/qt5_single_tools/Config.in"
		source "$BR2_EXTERNAL_OrangePi_4_PATH/package/qt5_single/qt5_single_virtualkeyboard/Config.in"
		# source "$BR2_EXTERNAL_OrangePi_4_PATH/package/qt5_single/qt5_single_wayland/Config.in"
		source "$BR2_EXTERNAL_OrangePi_4_PATH/package/qt5_single/qt5_single_webchannel/Config.in"
		# source "$BR2_EXTERNAL_OrangePi_4_PATH/package/qt5_single/qt5_single_webkit/Config.in"
		# source "$BR2_EXTERNAL_OrangePi_4_PATH/package/qt5_single/qt5_single_webengine/Config.in"
		source "$BR2_EXTERNAL_OrangePi_4_PATH/package/qt5_single/qt5_single_websockets/Config.in"
		# source "$BR2_EXTERNAL_OrangePi_4_PATH/package/qt5_single/qt5_single_webview/Config.in"
		# source "$BR2_EXTERNAL_OrangePi_4_PATH/package/qt5_single/qt5_single_x11extras/Config.in"
		source "$BR2_EXTERNAL_OrangePi_4_PATH/package/qt5_single/qt5_single_xmlpatterns/Config.in"

endif
```

## external/package/qt5_single/qt5_single_connectivity/Config.in
```kconfig
config BR2_PACKAGE_QT5_SINGLE_CONNECTIVITY
	bool "qt5connectivity"
# 	depends on BR2_PACKAGE_NEARD || BR2_PACKAGE_BLUEZ5_UTILS
	select BR2_PACKAGE_BLUEZ5_UTILS
	select BR2_PACKAGE_QT5_SINGLE_BASE_CONCURRENT
	select BR2_PACKAGE_QT5_SINGLE_BASE_DBUS
	help
	  Qt is a cross-platform application and UI framework for
	  developers using C++.

	  Qt Connectivity module provides support for Bluetooth/NFC
	  peripherials.

	  https://doc.qt.io/qt-5/qtbluetooth-index.html
	  https://doc.qt.io/qt-5/qtnfc-index.html

comment "qt5connectivity needs neard and/or bluez5_utils"
	depends on !BR2_PACKAGE_NEARD && !BR2_PACKAGE_BLUEZ5_UTILS
```

## external/package/qt5_single/qt5_single_declarative/Config.in
```kconfig
config BR2_PACKAGE_QT5_SINGLE_DECLARATIVE
	bool "qt5declarative"
	depends on BR2_PACKAGE_QT5_SINGLE_JSCORE_AVAILABLE
	help
	  Qt is a cross-platform application and UI framework for
	  developers using C++.

	  Qt Declarative module provides the Qt QML and Qt Quick
	  modules for developing UIs with the QML language

	  https://doc.qt.io/qt-5/qtqml-index.html
	  https://doc.qt.io/qt-5/qtquick-index.html

if BR2_PACKAGE_QT5_SINGLE_DECLARATIVE

config BR2_PACKAGE_QT5_SINGLE_DECLARATIVE_QUICK
	bool "quick module"
	select BR2_PACKAGE_QT5_SINGLE_BASE_GUI
	select BR2_PACKAGE_QT5_SINGLE_BASE_OPENGL if BR2_PACKAGE_QT5_SINGLE_GL_AVAILABLE

endif
```
