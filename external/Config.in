## external/package/qt5_single/qt5_single_graphicaleffects/Config.in
```kconfig
config BR2_PACKAGE_QT5_SINGLE_GRAPHICALEFFECTS
	bool "qt5graphicaleffects"
	depends on BR2_PACKAGE_QT5_SINGLE_GL_AVAILABLE
	depends on BR2_PACKAGE_QT5_SINGLE_JSCORE_AVAILABLE
	select BR2_PACKAGE_QT5_SINGLE_DECLARATIVE
	select BR2_PACKAGE_QT5_SINGLE_DECLARATIVE_QUICK
	help
	  Qt is a cross-platform application and UI framework for
	  developers using C++.

	  The Qt Graphical Effects module provides a set of QML types
	  for adding visually impressive and configurable effects to
	  user interfaces.

	  https://doc.qt.io/qt-5/qtgraphicaleffects-index.html

comment "qt5graphicaleffects needs an OpenGL-capable backend"
	depends on !BR2_PACKAGE_QT5_SINGLE_GL_AVAILABLE
	depends on BR2_PACKAGE_QT5_SINGLE_JSCORE_AVAILABLE
```

## external/package/qt5_single/qt5_single_imageformats/Config.in
```kconfig
config BR2_PACKAGE_QT5_SINGLE_IMAGEFORMATS
	bool "qt5imageformats"
	select BR2_PACKAGE_QT5_SINGLE_BASE_GUI
	help
	  Qt is a cross-platform application and UI framework for
	  developers using C++.

	  The Qt Image Formats module provides plugins for
	  additional image formats: TIFF, MNG, TGA, WBMP

	  https://doc.qt.io/qt-5/qtimageformats-index.html
```

## external/package/qt5_single/qt5_single_lottie/Config.in
```kconfig
config BR2_PACKAGE_QT5_SINGLE_LOTTIE
	bool "qt5lottie"
	depends on BR2_PACKAGE_QT5_SINGLE_JSCORE_AVAILABLE
	select BR2_PACKAGE_QT5_SINGLE_DECLARATIVE
	select BR2_PACKAGE_QT5_SINGLE_DECLARATIVE_QUICK
	help
	  Qt is a cross-platform application and UI framework for
	  developers using C++.

	  This package corresponds to the qt5lottie module.

	  https://doc.qt.io/qt-5/qtlottieanimation-index.html
```

## external/package/qt5_single/qt5_single_multimedia/Config.in
```kconfig
config BR2_PACKAGE_QT5_SINGLE_MULTIMEDIA
	bool "qt5multimedia"
	select BR2_PACKAGE_ALSA_LIB
	select BR2_PACKAGE_PULSEAUDIO if BR2_PACKAGE_LIBGLIB2
	select BR2_PACKAGE_QT5_SINGLE_BASE_GUI
	select BR2_PACKAGE_QT5_SINGLE_BASE_NETWORK
	select BR2_PACKAGE_QT5_SINGLE_BASE_OPENGL_LIB if BR2_PACKAGE_QT5_SINGLE_BASE_OPENGL
	help
	  Qt is a cross-platform application and UI framework for
	  developers using C++.

	  The Qt Multimedia module provides a rich feature set that
	  enables you to easily take advantage of a platform's
	  multimedia capabilities such as media playback and the use
	  of camera and radio devices.

	  https://doc.qt.io/qt-5/multimediaoverview.html
```

## external/package/qt5_single/qt5_single_quickcontrols/Config.in
```kconfig
config BR2_PACKAGE_QT5_SINGLE_QUICKCONTROLS
	bool "qt5quickcontrols"
	depends on BR2_PACKAGE_QT5_SINGLE_JSCORE_AVAILABLE
	select BR2_PACKAGE_QT5_SINGLE_DECLARATIVE
	select BR2_PACKAGE_QT5_SINGLE_DECLARATIVE_QUICK
	help
	  Qt is a cross-platform application and UI framework for
	  developers using C++.

	  The Qt Quick Controls module provides a set of controls
	  that can be used to build complete interfaces in Qt Quick.

	  https://doc.qt.io/qt-5/qtquickcontrols-index.html
```

## external/package/qt5_single/qt5_single_quickcontrols2/Config.in
```kconfig
config BR2_PACKAGE_QT5_SINGLE_QUICKCONTROLS2
	bool "qt5quickcontrols2"
	depends on BR2_PACKAGE_QT5_SINGLE_JSCORE_AVAILABLE # qt5_single_declarative/quick
	select BR2_PACKAGE_QT5_SINGLE_DECLARATIVE
	select BR2_PACKAGE_QT5_SINGLE_DECLARATIVE_QUICK
	help
	  Qt is a cross-platform application and UI framework for
	  developers using C++.

	  This package corresponds to the qt5quickcontrols2 module.

	  This module was in tech preview in Qt 5.6, and promoted
	  to a core module in Qt 5.7.0.

	  https://doc.qt.io/qt-5/qtquickcontrols-index.html
```

## external/package/qt5_single/qt5_single_quicktimeline/Config.in
```kconfig
config BR2_PACKAGE_QT5_SINGLE_QUICKTIMELINE
	bool "qt5quicktimeline"
	depends on BR2_PACKAGE_QT5_SINGLE_JSCORE_AVAILABLE # qt5_single_declarative
	select BR2_PACKAGE_QT5_SINGLE_DECLARATIVE
	select BR2_PACKAGE_QT5_SINGLE_DECLARATIVE_QUICK
	help
	  Qt is a cross-platform application and UI framework for
	  developers using C++.

	  This package corresponds to the qt5quicktimeline module.

	  https://doc.qt.io/qt-5/qtquicktimeline-index.html
```

## external/package/qt5_single/qt5_single_scxml/Config.in
```kconfig
config BR2_PACKAGE_QT5_SINGLE_SCXML
	bool "qt5scxml"
	depends on BR2_PACKAGE_QT5_SINGLE_JSCORE_AVAILABLE # qt5_single_declarative
	select BR2_PACKAGE_QT5_SINGLE_DECLARATIVE
	help
	  Qt is a cross-platform application and UI framework for
	  developers using C++.

	  The Qt SCXML module provides functionality to create state
	  machines from SCXML files.

	  https://doc.qt.io/qt-5/qtscxml-index.html
```

## external/package/qt5_single/qt5_single_sensors/Config.in
```kconfig
config BR2_PACKAGE_QT5_SINGLE_SENSORS
	bool "qt5sensors"
	help
	  Qt is a cross-platform application and UI framework for
	  developers using C++.

	  The Qt Sensors API provides access to sensor hardware
	  via QML and C++ interfaces.

	  https://doc.qt.io/qt-5/qtsensors-index.html
```

## external/package/qt5_single/qt5_single_webchannel/Config.in
```kconfig
config BR2_PACKAGE_QT5_SINGLE_WEBCHANNEL
	bool "qt5webchannel"
	select BR2_PACKAGE_QT5_SINGLE_WEBSOCKETS
	help
	  Qt is a cross-platform application and UI framework for
	  developers using C++.

	  Qt WebChannel enables peer-to-peer communication between
	  a server (QML/C++ application) and a client
	  (HTML/JavaScript or QML application).

	  https://doc.qt.io/qt-5/qtwebchannel-index.html
```
